/*@!Encoding:1252*/
includes
{
  
}

variables
{
  message 0x100 Txmsg1;
  int datasize;
  msTimer STMin;
  int frame_seq;
  int count;
}

on start
{
  write("Tx : started");
  write("Tx : segmented data tr initiated");
  write("TX : transmit more than 7 bytes of data");
  Txmsg1.dlc=8;
  datasize=20;
  count=0;
  //count=1;
}


on key 'r'
{
  Txmsg1.byte(0)=0x10;
  Txmsg1.byte(1)=0x0F;
  Txmsg1.byte(2)=count++;
  Txmsg1.byte(3)=count++;
  Txmsg1.byte(4)=count++;
  Txmsg1.byte(5)=count++;
  Txmsg1.byte(6)=count++;
  Txmsg1.byte(7)=count++;
  datasize=datasize-6;
  write("Tx: pending bytes to send = %d",datasize);
  output(Txmsg1);
  
}


on message 0x200
{
  write("Tx: flow control frame recieved");
  if((this.byte(0)==0x30)&& this.byte(1)==0x00)
  {
    frame_seq=1;
    if(this.byte(2)>0 && this.byte(2)<=0x7F)
      setTimerCyclic(STMin,this.byte(2));
    else
      setTimerCyclic(STMin,100);
  }
}


on timer STMin
{
  if(datasize>0)
  {
    Txmsg1.byte(0)=2<<4|frame_seq;
    Txmsg1.byte(1)=count++;
    Txmsg1.byte(2)=count++;
    Txmsg1.byte(3)=count++;
    Txmsg1.byte(4)=count++;
    Txmsg1.byte(5)=count++;
    Txmsg1.byte(6)=count++;
    Txmsg1.byte(7)=count++;
    write("Tx: frame sent= %X\n",Txmsg1.byte(0));
    write("Tx: pending bytes to be sent = %d",datasize);
    datasize=datasize-7;
    output(Txmsg1);
    frame_seq++;
    if(frame_seq==16)
      frame_seq=0;
  }
  else
    cancelTimer(STMin);
}

